## meta-trustedsubstrate/conf/machine/tsqemuarm64-secureboot.conf
```bitbake
MACHINEOVERRIDES =. "qemuarm64:"

require ${COREBASE}/meta/conf/machine/qemuarm64.conf

KMACHINE = "qemuarm64"

PREFERRED_PROVIDER_virtual/kernel = 'linux-dummy'

UBOOT_MACHINE = "qemu_arm64_defconfig"

IMAGE_CLASSES += "wic_nopt"
IMAGE_FSTYPES = " wic.gz"
WKS_FILE = "ts-qemuarm64.wks.in"
WKS_FILE_DEPENDS = "trusted-firmware-a"
IMAGE_BOOT_FILES = "flash.bin u-boot.bin"
EFI_PROVIDER = ""
```
